/dts-v1/;
/plugin/;

/ {
	fragment@0 {
		target-path = "/iommu@27960800";

		__overlay__ {
			status = "okay";
		};
	};

	fragment@1 {
		target-path = "/vdpp@27961000";

		__overlay__ {
			status = "okay";
		};
	};
};
